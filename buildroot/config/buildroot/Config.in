## buildroot/config/buildroot/Config.in
```kconfig
menu "allwinner platform private package select"

menu "power"

endmenu

menu "platform"
source "../config/buildroot/allwinner/platform/Config.in"
endmenu

menu "system"
source "../config/buildroot/allwinner/system/ota/ota-burnboot/Config.in"
endmenu

menu "usb"
source "../config/buildroot/allwinner/usb/mtp/Config.in"
source "../config/buildroot/allwinner/usb/adbd/Config.in"
endmenu

menu "powerkey"
source "../config/buildroot/allwinner/powerkey_display/Config.in"
source "../config/buildroot/allwinner/powerkey_suspend/Config.in"
endmenu

menu "utils"
source "../config/buildroot/allwinner/utils/boot-play/Config.in"
source "../config/buildroot/allwinner/utils/cpu_monitor/Config.in"
source "../config/buildroot/allwinner/utils/mtop/Config.in"
endmenu

menu "qt5_external"
source "../config/buildroot/qt5_external/Config.in"
endmenu

menu "qt-demo"
source "../config/buildroot/qt-demo/qt-launcher/Config.in"
source "../config/buildroot/qt-demo/launcher-martin/Config.in"
source "../config/buildroot/qt-demo/qt-keypad/Config.in"
source "../config/buildroot/qt-demo/qt-rtc/Config.in"
source "../config/buildroot/qt-demo/qt-watchdog/Config.in"
endmenu

menu "wireless"
source "../config/buildroot/allwinner/wireless/wifimanager/Config.in"
source "../config/buildroot/allwinner/wireless/wireless_common/Config.in"
source "../config/buildroot/allwinner/wireless/btmanager/Config.in"
source "../config/buildroot/wifi-firmware/Config.in"
endmenu

menu busybox-init-base-files
source "../config/buildroot/allwinner/system/busybox-init-base-files/Config.in"
endmenu

menu "multimedia"

menu libcedarx
source "../config/buildroot/allwinner/multimedia/libcedarx/Config.in"
endmenu

menu "libtmedia"
source "../config/buildroot/allwinner/multimedia/tina_multimedia_demo/Config.in"
source "../config/buildroot/allwinner/multimedia/libtmedia/Config.in"
endmenu

menu libcedarc
source "../config/buildroot/allwinner/multimedia/libcedarc/Config.in"
endmenu

menu libcedare
source "../config/buildroot/allwinner/multimedia/libcedare/Config.in"
endmenu

menu "libcedarse"
source "../config/buildroot/allwinner/multimedia/libcedarse/Config.in"
endmenu

endmenu

menu "lvgl"
source "../config/buildroot/lvgl-8/Config.in"
endmenu

menu "display"
source "../config/buildroot/allwinner/pqd/Config.in"
source "../config/buildroot/libuapi/Config.in"
source "../config/buildroot/gpu_um_pub/Config.in"
endmenu

menu "openamp"
source "../config/buildroot/amp_shell/Config.in"
source "../config/buildroot/rpmsg/Config.in"
source "../config/buildroot/rpbuf/Config.in"
endmenu


menu "ai-sdk"
source "../config/buildroot/ai-sdk/Config.in"
endmenu

endmenu
```

## buildroot/config/buildroot/ai-sdk/Config.in
```kconfig
config BR2_PACKAGE_AI_SDK
	bool "ai sdk"
	help
	  ai sdk.

if BR2_PACKAGE_AI_SDK
config BR2_PACKAGE_AI_SDK_VIPLITTE
	bool "ai sdk viplite lib"
	help
	    NPU viplite framework for allwinner

config BR2_PACKAGE_AI_SDK_VIPLITTE_SAMPLE
	bool "ai sdk viplite sample"
	depends on BR2_PACKAGE_AI_SDK_VIPLITTE
	help
	    Whether install viplite sample

config BR2_PACKAGE_AI_SDK_UNIFY
	bool "ai sdk unify lib"
	help
	    NPU unify framework for allwinner
endif
```

## buildroot/config/buildroot/allwinner/multimedia/libcedare/Config.in
```kconfig
config BR2_PACKAGE_LIBCEDARE
	bool "libcedare"
	select BR2_PACKAGE_LIBCEDARX
	help
	  libcedare
if BR2_PACKAGE_LIBCEDARE
menu "libcedare-demo"
comment "Select libcedare demo"
source "../config/buildroot/allwinner/multimedia/libcedare/aenc_comp_demo/Config.in"
source "../config/buildroot/allwinner/multimedia/libcedare/recorder_demo/Config.in"
source "../config/buildroot/allwinner/multimedia/libcedare/venc_comp_demo/Config.in"
endmenu
endif
```

## buildroot/config/buildroot/allwinner/multimedia/libcedare/aenc_comp_demo/Config.in
```kconfig
config BR2_PACKAGE_AEENC_COMP_DEMO
	bool "aenc_comp_demo"
	depends on BR2_PACKAGE_LIBCEDARE
	help
	  Dynamic-link library of aenc_comp_demo
```

## buildroot/config/buildroot/allwinner/multimedia/libcedare/recorder_demo/Config.in
```kconfig
config BR2_PACKAGE_RECORDER_DEMO
	bool "recorder_demo"
	depends on BR2_PACKAGE_LIBCEDARE
	help
	  Dynamic-link library of recorder_demo
```

## buildroot/config/buildroot/allwinner/multimedia/libcedare/venc_comp_demo/Config.in
```kconfig
config BR2_PACKAGE_VENC_COMP_DEMO
	bool "venc_comp_demo"
	depends on BR2_PACKAGE_LIBCEDARE
	help
	  Dynamic-link library of venc_comp_demo
```

## buildroot/config/buildroot/allwinner/multimedia/libcedarse/Config.in
```kconfig
config BR2_PACKAGE_LIBCEDARSE
	bool "Support sunxi libcedarse"
	help
	  Support sunxi libcedarse

config BR2_PACKAGE_CEDARSE_PARM_ADJUST
	bool "cedarSE parm adjust"
	depends on BR2_PACKAGE_LIBCEDARSE
	help
	  cedarSE parm adjust

config BR2_PACKAGE_CEDARSE_DEMO
	bool "cedarSE demo"
	depends on BR2_PACKAGE_LIBCEDARSE
	depends on BR2_PACKAGE_RPBUF
	help
	  cedarSE demo
```

## buildroot/config/buildroot/allwinner/multimedia/libcedarx/Config.in
```kconfig
config BR2_PACKAGE_LIBCEDARX
	bool "libcedarx"
	select BR2_PACKAGE_OPENSSL
	select BR2_PACKAGE_ZLIB
	select BR2_PACKAGE_LIBCEDARC
	select BR2_PACKAGE_ALSA_LIB
	default y
	help
	  libcedarx
```

## buildroot/config/buildroot/allwinner/multimedia/libtmedia/Config.in
```kconfig
source "../config/buildroot/allwinner/multimedia/libtmedia/tplayer/Config.in"
source "../config/buildroot/allwinner/multimedia/libtmedia/jpegdecode/Config.in"
source "../config/buildroot/allwinner/multimedia/libtmedia/trecorder/Config.in"
```

## buildroot/config/buildroot/allwinner/multimedia/libtmedia/jpegdecode/Config.in
```kconfig
config BR2_PACKAGE_JPEGDECODE
	bool "libjpegdecode"
	depends on BR2_PACKAGE_LIBCEDARX
	default y
	help
	  Dynamic-link library of jpegdecode
```

## buildroot/config/buildroot/allwinner/multimedia/libtmedia/tplayer/Config.in
```kconfig
config BR2_PACKAGE_TPLAYER
    bool "libtplayer"
    depends on BR2_PACKAGE_LIBCEDARX
    select BR2_PACKAGE_LIBUAPI
    help
        Dynamic-link library of tplayer

config TINA_PACKAGE_PATH_PREFIX
    string
    prompt "tina multimedia package path prefix: openwrt or buildroot"
    default openwrt
    help
        set to openwrt or buildroot.
```

## buildroot/config/buildroot/allwinner/multimedia/libtmedia/trecorder/Config.in
```kconfig
config BR2_PACKAGE_TRECORDER
	bool "libtrecorder"
	depends on BR2_PACKAGE_LIBCEDARX
	help
	  Dynamic-link library of trecorder

config DEFAULT_SOUNDCARD
    int
    prompt "Choose default card"
    depends on BR2_PACKAGE_TRECORDER
    default 0
    help
        Choose which soundcard to recorder
config DEFAULT_DEVICE
    int
    prompt "Choose default pcm device"
    depends on BR2_PACKAGE_TRECORDER
    default 0
    help
        choose which pcm device to recorder.
```

## buildroot/config/buildroot/allwinner/multimedia/tina_multimedia_demo/Config.in
```kconfig
if BR2_PACKAGE_LIBCEDARX
menu "tina_multimedia_demo"
config CONFIG_XPLAYER_DEMO
    bool "xplayerdemo"
    default n
    help
        xplayerdemo

source "../config/buildroot/allwinner/multimedia/tina_multimedia_demo/tplayerdemo/Config.in"
source "../config/buildroot/allwinner/multimedia/tina_multimedia_demo/trecorderdemo/Config.in"
source "../config/buildroot/allwinner/multimedia/tina_multimedia_demo/backplaydemo/Config.in"
source "../config/buildroot/allwinner/multimedia/tina_multimedia_demo/jpegdecodedemo/Config.in"
source "../config/buildroot/allwinner/multimedia/tina_multimedia_demo/encodertest/Config.in"

endmenu
endif
```

## buildroot/config/buildroot/allwinner/multimedia/tina_multimedia_demo/backplaydemo/Config.in
```kconfig
config BR2_PACKAGE_BACKPLAYDEMO
    bool "backplaydemo"
    depends on BR2_PACKAGE_TPLAYER
    help
        demo for playing video in background
```

## buildroot/config/buildroot/allwinner/multimedia/tina_multimedia_demo/encodertest/Config.in
```kconfig
config BR2_PACKAGE_ENCODERTEST
    bool "encodertest"
    depends on BR2_PACKAGE_LIBCEDARX
    help
        demo for encoding h264/jpeg
```

## buildroot/config/buildroot/allwinner/multimedia/tina_multimedia_demo/jpegdecodedemo/Config.in
```kconfig
config BR2_PACKAGE_JPEGDECODEDEMO
    bool "jpegdecodedemo"
    depends on BR2_PACKAGE_JPEGDECODE
    help
        demo for decoding jpeg
```

## buildroot/config/buildroot/allwinner/multimedia/tina_multimedia_demo/tplayerdemo/Config.in
```kconfig
config BR2_PACKAGE_TPLAYERDEMO
    bool "tplayerdemo"
    depends on BR2_PACKAGE_TPLAYER
    help
        demo for playing video
```

## buildroot/config/buildroot/allwinner/multimedia/tina_multimedia_demo/trecorderdemo/Config.in
```kconfig
config BR2_PACKAGE_TRECORDERDEMO
    bool "treocrderdemo"
    depends on BR2_PACKAGE_TRECORDER
    help
        demo for video recording
```

## buildroot/config/buildroot/allwinner/platform/Config.in
```kconfig
# SPDX-License-Identifier: GPL-2.0-only


menu "Allwinner Platform Selection"

choice
	prompt "Select SoC Family"
	default BR2_ARCH_SUNXX
	help
	  Select the Family for SoC

config BR2_ARCH_SUN8I
	bool "Allwinner SUN8I"
	depends on BR2_arm
	help
	  Allwinner SUN8I SoC Family

config BR2_ARCH_SUN50I
	bool "Allwinner SUN50I"
	depends on BR2_aarch64
	help
	  Allwinner SUN50I SoC Family

config BR2_ARCH_SUN55I
	bool "Allwinner SUN55I"
	depends on BR2_aarch64
	help
	  Allwinner SUN55I SoC Family

config BR2_ARCH_SUN60I
	bool "Allwinner SUN60I"
	depends on BR2_aarch64
	help
	  Allwinner SUN60I SoC Family

config BR2_ARCH_SUNXX
	bool "NONE"
	help
	  Allwinner NONE SoC Family


endchoice

choice
	prompt "Select the Wafer"
	default BR2_ARCH_SUNXXXWXX
	help
	  Select the wafer

config BR2_ARCH_SUN50IW9
	bool "SUN50IW9"
	depends on BR2_ARCH_SUN50I
	help
	  Support for Allwinner SUN50IW9 SoC

config BR2_ARCH_SUN50IW10
	bool "SUN50IW10"
	depends on BR2_ARCH_SUN50I
	help
	  Support for Allwinner SUN50IW10 SoC

config BR2_ARCH_SUN50IW12
	bool "SUN50IW12"
	depends on BR2_ARCH_SUN50I
	help
	  Support for Allwinner SUN50IW12 SoC

config BR2_ARCH_SUN55IW3
	bool "SUN55IW3"
	depends on BR2_ARCH_SUN55I
	help
	  Support for Allwinner SUN55IW3 SoC


config BR2_ARCH_SUN8IW11
	bool "SUN8IW11"
	depends on BR2_ARCH_SUN8I
	help
	  Support for Allwinner SUN8IW11 SoC

config BR2_ARCH_SUN8IW18
	bool "SUN8IW18"
	depends on BR2_ARCH_SUN8I
	help
	  Support for Allwinner SUN8IW18 SoC

config BR2_ARCH_SUN8IW20
	bool "SUN8IW20"
	depends on BR2_ARCH_SUN8I
	help
	  Support for Allwinner SUN8IW20 SoC

config BR2_ARCH_SUNXXXWXX
	bool "NONE"
	help
	  Support for Allwinner NONE SoC

endchoice

choice
	prompt "Select the SoC"
	help
	  Select the SoC

config BR2_ARCH_SUN50IW10P1
	depends on BR2_ARCH_SUN50IW10
	bool "Allwinner SUN50IW10P1"

config BR2_ARCH_SUN55IW3P1
	depends on BR2_ARCH_SUN55IW3
	bool "Allwinner SUN55IW3P1"

config BR2_ARCH_SUNXXXWXXPX
	bool "NONE"
	help
	  Support for Allwinner NONE SoC

endchoice


config AW_SOC_NAME
	string "SoC Name"
	default ""
	depends on AW_BSP
	help
	  Used by sysfs: /sys/.../sysinfo

endmenu
```

## buildroot/config/buildroot/allwinner/powerkey_display/Config.in
```kconfig
config BR2_PACKAGE_POWERKEY_DISPLAY
	bool "powerkey_display"
	help
	  powerkey support close and open the screen
```

## buildroot/config/buildroot/allwinner/powerkey_suspend/Config.in
```kconfig
config BR2_PACKAGE_POWERKEY_SUSPEND
	bool "powerkey_suspend"
	help
	  powerkey support suspend
```

## buildroot/config/buildroot/allwinner/pqd/Config.in
```kconfig
config BR2_PACKAGE_PQD
	bool "pqd"
	help
	  pqd is deamon for display picture quality debug.
```

## buildroot/config/buildroot/allwinner/system/busybox-init-base-files/Config.in
```kconfig
config BR2_PACKAGE_BUSYBOX_INIT_BASE_FILES
	bool "busybox-init-base-files"
	help
	  update files for rootfs
```

## buildroot/config/buildroot/allwinner/wireless/btmanager/Config.in
```kconfig
config BR2_PACKAGE_BTMANAGER
	bool "btmanager-core"
	select BR2_PACKAGE_BLUEZ5_UTILS
	select BR2_PACKAGE_WIRELESS_COMMON
	select BR2_PACKAGE_DBUS
	select BR2_PACKAGE_LIBGLIB2
	select BR2_PACKAGE_ALSA_LIB
	select BR2_PACKAGE_JSON_C
	select BR2_PACKAGE_BLUEZ_ALSA
	help
	  bluetooth manager core

config BR2_PACKAGE_BTMG_DEMO
	bool "Enable btmanager demo support"
	depends on BR2_PACKAGE_BTMANAGER
	help
	  btmanager demo bt_test
```
