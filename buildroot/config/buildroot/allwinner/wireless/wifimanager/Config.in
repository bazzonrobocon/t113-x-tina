## buildroot/config/buildroot/allwinner/wireless/wifimanager/Config.in
```kconfig
# wifimanager
config BR2_PACKAGE_WIFIMANAGER
	bool "wifimanager-v2.0"
	help
	Tina wifimanager-v2.0

config BR2_PACKAGE_WIFIMANAGER_LIB
	bool "wifimanager-v2.0-lib"
	depends on BR2_PACKAGE_WIFIMANAGER
	select BR2_PACKAGE_WIRELESS_COMMON
	select BR2_PACKAGE_LIBNL
	select BR2_PACKAGE_WIRELESS_BTMANAGER
	help
	Tina wifimanager-v2.0 lib

config BR2_PACKAGE_WIFIMANAGER_DEMO
	bool "Tina wifimanager-v2.0-demo"
	depends on BR2_PACKAGE_WIFIMANAGER_LIB
	help
	Tina wifimanager-v2.0 app demo
```

## buildroot/config/buildroot/allwinner/wireless/wireless_common/Config.in
```kconfig
config BR2_PACKAGE_WIRELESS_COMMON
	bool "wireless_common"
	help
	  Wi-Fi/BT api_action and log tracing
```

## buildroot/config/buildroot/gpu_um_pub/Config.in
```kconfig
config BR2_PACKAGE_GPU_UM_PUB
	bool "Support SUNXI GPU_UM_PUB"
	help
	  Support SUNXI GPU_UM_PUB
```

## buildroot/config/buildroot/qt-demo/launcher-martin/Config.in
```kconfig
config BR2_PACKAGE_LAUNCHER_MARTIN
	bool "launcher-martin"
	depends on BR2_PACKAGE_QT5_EXTERNAL || BR2_PACKAGE_QT5BASE
	help
	  launcher ui for app
```

## buildroot/config/buildroot/qt-demo/qt-keypad/Config.in
```kconfig
config BR2_PACKAGE_QT_KEYPAD
	bool "keypad for qt"
	depends on BR2_PACKAGE_QT5_EXTERNAL || BR2_PACKAGE_QT5BASE
	help
	  keypad ui for test
```

## buildroot/config/buildroot/qt-demo/qt-launcher/Config.in
```kconfig
config BR2_PACKAGE_QT_LAUNCHER
	bool "Launcher for qt"
	depends on BR2_PACKAGE_QT5_EXTERNAL || BR2_PACKAGE_QT5BASE
	help
	  launcher ui for test
```

## buildroot/config/buildroot/qt-demo/qt-rtc/Config.in
```kconfig
config BR2_PACKAGE_QT_RTC
	bool "rtc for qt"
	depends on BR2_PACKAGE_QT5_EXTERNAL || BR2_PACKAGE_QT5BASE
	help
	  rtc ui for test
```

## buildroot/config/buildroot/qt-demo/qt-watchdog/Config.in
```kconfig
config BR2_PACKAGE_QT_WATCHDOG
	bool "watchdog for qt"
	depends on BR2_PACKAGE_QT5_EXTERNAL || BR2_PACKAGE_QT5BASE
	help
	  watchdog ui for test
```

## buildroot/config/buildroot/qt5_external/Config.in
```kconfig
config BR2_PACKAGE_QT5_EXTERNAL
	bool "qt5.12.5 externel"
	depends on BR2_PACKAGE_GPU_UM_PUB
	help
	  This option enables the Qt5 framework.
```

## buildroot/config/buildroot/rpbuf/Config.in
```kconfig
config BR2_PACKAGE_RPBUF
	bool "rpbuf"
	help
	  amp rpbuf.

if BR2_PACKAGE_RPBUF
config BR2_PACKAGE_RPBUF_DEMO
	bool "rpbuf demo"
	help
	  rpbuf demo

config BR2_PACKAGE_RPBUF_TEST
	bool "rpbuf test"
	help
	  rpbuf test
endif
```

## buildroot/config/buildroot/rpmsg/Config.in
```kconfig
config BR2_PACKAGE_RPMSG
	bool "rpmsg"
	help
	  amp rpmsg.

if BR2_PACKAGE_RPMSG
config BR2_PACKAGE_RPMSG_DEMO
	bool "rpmsg demo"
	help
	  rpmsg demo

config BR2_PACKAGE_RPMSG_TEST
	bool "rpmsg test"
	help
	  rpmsg test
endif
```

## buildroot/config/buildroot/wifi-firmware/Config.in
```kconfig
menu "firmware"
config BR2_PACKAGE_WIFI_FIRMWARE
	bool "wifi bt firmware"
	help
	  copy wifi bt firmware to rootfs

if BR2_PACKAGE_WIFI_FIRMWARE

config BR2_PACKAGE_RTL8723DS_FIRMWARE
	bool "rtl8723ds-firmware"
	help
	  rtl8723ds firmware.

config BR2_PACKAGE_RTL8733BS_FIRMWARE
	bool "rtl8733bs-firmware"
	help
	  rtl8733bs firmware.

config BR2_PACKAGE_RTL8821CS_FIRMWARE
	bool "rtl8821cs-firmware"
	help
	  rtl8821cs firmware.

config BR2_PACKAGE_AIC8800_FIRMWARE
	bool "aic8800-firmware"
	help
	  aic8800 firmware.

config BR2_PACKAGE_SSV6158_FIRMWARE
	bool "ssv6158-firmware"
	help
	  ssv6158 firmware.

config BR2_PACKAGE_XR819_FIRMWARE
	bool "xr819-firmware"
	help
	  xr819 firmware.

config BR2_PACKAGE_XR819A_FIRMWARE
	bool "xr819a-firmware"
	help
	  xr819a firmware.

config BR2_PACKAGE_XR829_FIRMWARE
	bool "xr829-firmware"
	help
	  xr829 firmware.

config BR2_PACKAGE_XR829_USE_40M
	bool "xr829_40M"
	depends on BR2_PACKAGE_XR829_FIRMWARE
	help
	  xr829 40M crystal oscillator.

config BR2_PACKAGE_XR829_USE_24M
	bool "xr829_24M"
	depends on BR2_PACKAGE_XR829_FIRMWARE
	help
	  xr829 24M crystal oscillator.

config BR2_PACKAGE_XR819S_FIRMWARE
	bool "xr819s-firmware"
	help
	  xr819s firmware.

config BR2_PACKAGE_XR819S_USE_40M
	bool "xr819s_40M"
	depends on BR2_PACKAGE_XR819S_FIRMWARE
	help
	  xr819s 40M crystal oscillator.

config BR2_PACKAGE_XR819S_USE_24M
	bool "xr819s_24M"
	depends on BR2_PACKAGE_XR819S_FIRMWARE
	help
	  xr819s 24M crystal oscillator.

endif

endmenu
```
